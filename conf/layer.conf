## conf/layer.conf
```bitbake
# We have a conf and classes directory, add to BBPATH
BBPATH .= ":${LAYERDIR}"

# We have recipes-* directories, add to BBFILES
BBFILES += "${LAYERDIR}/recipes-*/*/*.bb \
            ${LAYERDIR}/recipes-*/*/*.bbappend"

BBFILE_COLLECTIONS += "meta-remotedevice"
BBFILE_PATTERN_meta-remotedevice = "^${LAYERDIR}/"
BBFILE_PRIORITY_meta-remotedevice = "10"

LAYERDEPENDS_meta-remotedevice = "rauc raspberrypi"

LAYERSERIES_COMPAT_meta-remotedevice = "zeus"
```

## wic/revolutionpi-custom.wks
```
# short-description: Create Raspberry Pi SD card image.
# long-description: Creates a partitioned SD card image for use with
# Raspberry Pi. Boot files are located in the first vfat partition.

part --align 4 --fixed-size 1 --no-table
part /boot --source bootimg-partition --ondisk mmcblk0 --fstype=vfat --label boot --active --align 4 --size 40
part / --source rootfs --ondisk mmcblk0 --fstype=ext4 --label A --align 4 --use-uuid --size 1024
part --source rootfs --ondisk mmcblk0 --fstype=ext4 --label B --align 4 --use-uuid --size 1024
part /data --ondisk mmcblk --fstype=ext4 --label data --size 128M --align 4 --extra-space 0
```
